#include "dactyl.dtsi"

&default_transform {
  col-offset = <6>;
};

&kscan0 {
	col-gpios
	  = <&pro_micro 31 GPIO_ACTIVE_HIGH>
	  = <&pro_micro 29 GPIO_ACTIVE_HIGH>
	  = <&pro_micro 02 GPIO_ACTIVE_HIGH>
	  ;
};
